## conf/distro/summitsom-greengrass.conf
```bitbake
require conf/distro/summitsom-cmd-secure.conf

DISTRO = "summitsom-greengrass"
DISTRO_NAME = "Summit SOM Greengrass Distro"

PREFERRED_PROVIDER_virtual/java-initial-native = "cacao-initial-native"
PREFERRED_PROVIDER_virtual/java-native = "jamvm-native"
PREFERRED_PROVIDER_virtual/javac-native = "ecj-bootstrap-native"
```
